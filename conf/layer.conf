## conf/layer.conf
```bitbake
# We have a conf and classes directory, add to BBPATH
BBPATH .= ":${LAYERDIR}"

# We have recipes-* directories, add to BBFILES
BBFILES += "${LAYERDIR}/recipes-*/*/*.bb \
            ${LAYERDIR}/recipes-*/*/*.bbappend"

BBFILE_COLLECTIONS += "meta-zedboard"
BBFILE_PATTERN_meta-zedboard = "^${LAYERDIR}/"
BBFILE_PRIORITY_meta-zedboard = "16"

LAYERDEPENDS_meta-zedboard = "core xilinx xilinx-bsp xilinx-standalone xilinx-vendor xilinx-tools security"
LAYERSERIES_COMPAT_meta-zedboard = "kirkstone"

UBOOT_SIGN_KEYDIR = "${LAYERDIR}/fit-keys"
```

## conf/machine/ws-zed.conf
```bitbake
require conf/machine/zedboard-zynq7.conf

EXTRA_IMAGEDEPENDS:remove = "qemu-system-native qemu-helper-native:do_addto_recipe_sysroot "
BBMASK += "qemu-xilinx-*"
UBOOT_BINARY = "u-boot.elf"
PREFERRED_PROVIDER_virtual/boot-bin = "zynq-bootbin"

unset HDF_MACHINE
HDF_MACHINE = "zedboard-zynq7"

IMAGE_FSTYPES:remove = "wic.qemu-sd"

KERNEL_CLASSES += "kernel-fitimage"
KERNEL_IMAGETYPES = "zImage fitImage"

#INITRAMFS_IMAGE = "core-image-minimal-initramfs"
#INITRAMFS_IMAGE_NAME = "core-image-minimal"
#INITRAMFS_IMAGE_BUNDLE = "1"

# Enables fitImage signing with key populated inside u-boot.dtb
UBOOT_SIGN_ENABLE = "1"
UBOOT_DTB_BINARY = "u-boot.dtb"
# If keys are not present, create directory with new DEVELOPMENT KEYS
FIT_GENERATE_KEYS = "1"
UBOOT_SIGN_KEYDIR = "${DEPLOY_DIR_IMAGE}/fit-keys"
UBOOT_SIGN_KEYNAME = "fitImage"

IMAGE_INSTALL:append = " mtd-utils"
ZED_DEPLOY_DIR = "${DEPLOY_DIR_IMAGE}/zed-deploy"

DISTRO_FEATURES:append = " systemd"
DISTRO_FEATURES_BACKFILL_CONSIDERED += "sysvinit"
INIT_MANAGER = "systemd"
VIRTUAL-RUNTIME_init_manager = "systemd"
VIRTUAL-RUNTIME_initscripts = "systemd-compat-units"
```
